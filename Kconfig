## Kconfig
```kconfig
config USR_LIB_GUI
  bool  "Wookey project Graphic user interface abstraction"
  default y
  ---help---
  Support for graphic user interface API for embedded system.
  Still oriented for the Wookey use case but targets a more
  generic usage.

if USR_LIB_GUI

menu "libgui configuration"

choice USR_LIB_GUI_MODE
  prompt "GUI mode"
  default USR_LIB_GUI_MODE_FULL
    config USR_LIB_GUI_MODE_FULL
      bool "Full graphical mode with icons"
      ---help---
      Add support for full graphical mode with iconset.
      More pretty but bigger.
     config USR_LIB_GUI_MODE_LITE
      bool "Lite graphical mode (no icon)"
      ---help---
      Add support for lite graphical mode without icon.
      Usefull for smaller systems or apps.
endchoice

config USR_LIB_GUI_MAX_MENU_NUMBER
   int "Max number of declarable menus"
   default 10
   ---help---
      Maximum number of menus that can be declared

config USR_LIB_GUI_MAX_TILE_NUMBER
   int "Max number of declarable tiles"
   default 32
   ---help---
      Maximum number of tiles that can be declared


endmenu

endif
```
